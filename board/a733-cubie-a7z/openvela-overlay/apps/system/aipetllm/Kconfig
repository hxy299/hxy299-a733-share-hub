## board/a733-cubie-a7z/openvela-overlay/apps/system/aipetllm/Kconfig
```kconfig
config SYSTEM_AIPETLLM
	tristate "AI Pet local GGUF LLM runtime"
	default n
	depends on ARCH_ARM64
	---help---
		Build the aipet-llm command.  The first-stage runtime validates the
		large-file, memory and GGUF metadata requirements for a local Qwen
		model.  It is also the stable command-line front end for the later
		llama.cpp CPU/NEON backend.

if SYSTEM_AIPETLLM

config AIPETLLM_PROGNAME
	string "Program name"
	default "aipetllm"

config AIPETLLM_PRIORITY
	int "Task priority"
	default 100

config AIPETLLM_STACKSIZE
	int "Task stack size"
	default 65536

config AIPETLLM_DEFAULT_MODEL
	string "Default GGUF model path"
	default "/data/models/qwen2.5-1.5b-instruct-q4_k_m.gguf"

endif
```
